## sdkconfig.defaults
```kconfig
# common settings (close to the Arduino IDE ESP32S3 board with OPI PSRAM, 16MB flash)
CONFIG_IDF_TARGET="esp32s3"
CONFIG_FREERTOS_HZ=1000
CONFIG_ESP_DEFAULT_CPU_FREQ_MHZ_240=y
CONFIG_AUTOSTART_ARDUINO=y
CONFIG_COMPILER_OPTIMIZATION_PERF=y

CONFIG_ESPTOOLPY_FLASHSIZE_16MB=y
CONFIG_ESPTOOLPY_FLASHMODE_QIO=y
CONFIG_PARTITION_TABLE_CUSTOM=y
CONFIG_PARTITION_TABLE_CUSTOM_FILENAME="partitions.csv"

CONFIG_SPIRAM=y
CONFIG_SPIRAM_MODE_OCT=y
CONFIG_SPIRAM_SPEED_80M=y
CONFIG_SPIRAM_USE_MALLOC=y

# LVGL uses firmware/lv_conf.h
CONFIG_LV_CONF_SKIP=n

CONFIG_LCD_RGB_RESTART_IN_VSYNC=y
```
